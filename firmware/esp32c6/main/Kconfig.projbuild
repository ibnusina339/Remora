## firmware/esp32c6/main/Kconfig.projbuild
```kconfig
menu "REMORA Rev K2"
config REMORA_LED_PIN
    int "Six-key SK6812 data GPIO (verify extra pad)"
    default 23
    range 0 30
config REMORA_CRITICAL_MV
    int "Full-cutoff voltage, millivolts (calibrate on the actual cell)"
    default 3200
config REMORA_ADC_SCALE_PERMILLE
    int "ADC/divider calibration scale, permille"
    default 1000
config REMORA_TFT_INVERT
    bool "Invert ST7789 panel colours"
    default y
config REMORA_TFT_MIRROR_X
    bool "Mirror landscape panel X"
    default y
config REMORA_TFT_MIRROR_Y
    bool "Mirror landscape panel Y"
    default n
endmenu
```

## firmware/esp32c6/sdkconfig.defaults
```kconfig
CONFIG_IDF_TARGET="esp32c6"
CONFIG_ESPTOOLPY_FLASHSIZE_4MB=y
CONFIG_PARTITION_TABLE_CUSTOM=y
CONFIG_PARTITION_TABLE_CUSTOM_FILENAME="partitions.csv"
CONFIG_BOOTLOADER_APP_ROLLBACK_ENABLE=y
CONFIG_ESP_MAIN_TASK_STACK_SIZE=12288
CONFIG_ESP_CONSOLE_USB_SERIAL_JTAG=y
# CONFIG_ESP_CONSOLE_NONE is not set
CONFIG_PM_ENABLE=y
# CONFIG_PM_POWER_DOWN_PERIPHERAL_IN_LIGHT_SLEEP is not set
CONFIG_MBEDTLS_CERTIFICATE_BUNDLE=y
CONFIG_MBEDTLS_CERTIFICATE_BUNDLE_DEFAULT_FULL=y
CONFIG_FREERTOS_HZ=1000
CONFIG_COMPILER_OPTIMIZATION_PERF=y
CONFIG_LV_COLOR_DEPTH_16=y
CONFIG_LV_USE_CANVAS=y
CONFIG_LV_USE_DRAW_SW=y
CONFIG_LV_DRAW_SW_SUPPORT_RGB565=y
CONFIG_LV_MEM_SIZE_KILOBYTES=32
CONFIG_LV_USE_LOG=n
CONFIG_LV_USE_OS=0
CONFIG_LV_DEF_REFR_PERIOD=16
```
